#include"Uart2.H"
#include"system.h"

#define S2_S0 	0x01              //P_SW2.0
#define S2RI  	0x01              //S2CON.0	  串行口2接收数据标志位
#define S2TI  	0x02              //S2CON.1	  串行口2发送数据标志位
#define S2REN   0X10			  //S2CON.4	  串行口2接收控制位
#define T2R     0x10              //AUXR.4	  定时器T2运行控制位
#define S1ST2   0x01              //AUXR.0	  选择定时器2作为串口2波特率发生器
#define ET2   0x04				//TE2.2   定时器2中断允许位


bit Sensor_Data_Flag = 0;
uchar TempV_1 = 0;				//读取串口2数据变量
uchar Rec_Adr = 0;				//激光测距模块数据接收数量位
uchar Pig = 0;					//激光测距模块数据报头数量位
uint  Sensor_Data[5] = {0};
uint distance;

/****************************************************************************************************
/*函数：void Uart2_Init(void)			   //@11.0592MHz
/*功能：串口2使用定时器T2产生波特率初始化函数
/*说明：
/*修改日期：2017-01-05
/*作者：华南理工大学广州学院电工电子创新实验室——叶成彬  
/****************************************************************************************************/
void Uart2_Init(void)
{
    P_SW2 &= ~S2_S0;            //S2_S0=0 (P1.0/RxD2, P1.1/TxD2)
//  P_SW2 |= S2_S0;             //S2_S0=1 (P4.6/RxD2_2, P4.7/TxD2_2) 参考用户手册744页
    
    S2CON = 0x50;                //9位可变波特率,校验位初始为0		 参考用户手册741页
	T2L = 0xD5;			//设定定时初值
	T2H = 0xFF;			//设定定时初值
	AUXR &= 0xFB;		//定时器2时钟为Fosc/12,即12T	20MHZ
	AUXR |= S1ST2;		//串口2选择定时器2为波特率发生器
	AUXR |= T2R;		//启动定时器2	 参考用户手册743页
	IE2 &= ~ET2;		//禁止定时器2产生中断
	S2CON |=  S2REN;	//允许串行接收控制位
    S2CON &= ~S2RI;     //清除S2RI位
	IE2 = 0x01;			//参考用户手册744页
    EA = 1;				//开总中断
}

/****************************************************************************************************
/*函数：void Uart2_SendData(uchar dat)			   //@11.0592MHz
/*功能：串口2发送数据函数
/*说明：
/*修改日期：2017-01-05
/*作者：华南理工大学广州学院电工电子创新实验室——叶成彬  
/****************************************************************************************************/
void Uart2_SendData(uchar dat)
{			
	S2CON &= ~S2TI;         //清除S2TI位			 参考用户手册539页
	S2BUF = dat;                 //写数据到UART数据寄存器
	while(!(S2CON & S2TI)); 	 //等待发送数据完毕

}

/****************************************************************************************************
/*函数：void Uart2_SendString(uchar *s)		   //@11.0592MHz
/*功能：串口2发送字符串函数
/*说明：
/*修改日期：2017-01-05
/*作者：华南理工大学广州学院电工电子创新实验室——叶成彬  
/****************************************************************************************************/
void Uart2_SendString(uchar *s)
{
    while(*s)                  //检测字符串结束标志
    {
        Uart2_SendData(*s++);         //发送当前字符
    }
}

/****************************************************************************************************
/*函数：void Uart2_Receive() interrupt 8		   //@11.0592MHz    参考用户手册533
/*功能：串口2接收收据中断服务函数
/*说明：
/*修改日期：2017-01-05
/*作者：华南理工大学广州学院电工电子创新实验室——叶成彬  
/****************************************************************************************************/
void Uart2_Receive() interrupt 8
{
    if(S2CON & S2RI)					//判断是否接收到数据
    {
        S2CON &= ~S2RI;         //清除S2RI
		TempV_1 = S2BUF;			//将串口接收到的数据保存到TempV_1变量中
 		switch(Pig)
		{
		 	case 0:
					if(TempV_1 == 0x5a) 	Pig++;
					else Pig = 0;
					break;
			case 1:
					if(TempV_1 == 0x5a) 	Pig++;
					else Pig = 0;
					break;	
			case 2:
					if(TempV_1 == 0x15) 	Pig++;
					else Pig = 0;
					break;					
			case 3:
				  Sensor_Data[Rec_Adr] = TempV_1;
					Rec_Adr++;
					if(Rec_Adr > 4)
					{
						Pig = 0;
						Sensor_Data_Flag = 1;		//接收到完整的5个16进制数据标志位
						Rec_Adr = 0;
						distance=((Sensor_Data[1]<<8)|Sensor_Data[2])/10;	//距离公式，直接得到距离，单位mm
					}
					break;
			default:
					break;						
		}	
	}				
}


















